## config/west.yml
```yaml
---
manifest:
  remotes:
    - name: zmkfirmware
      url-base: https://github.com/zmkfirmware
    - name: saixos
      url-base: https://github.com/nmunnich
  projects:
    - name: zmk
      # remote: zmkfirmware
      # revision: main
      remote: saixos
      revision: aa2294c1396e9d267b8883042e479dc0a9a37039
      import: app/west.yml
    # - name: zmk-component-rp2040-zero
    #   remote: saixos
    #   revision: main
  self:
    path: config
```
